//**********************************************************************
//*                SEGGER MICROCONTROLLER SYSTEME GmbH                 *
//*        Solutions for real time microcontroller applications        *
//**********************************************************************
//*                                                                    *
//*        (C) 2002-2004  SEGGER Microcontroller Systeme GmbH          *
//*                                                                    *
//*        www.segger.com         Support: support@segger.com          *
//*                                                                    *
//**********************************************************************
//
//----------------------------------------------------------------------
//File   : LPC2xxx_RAM.xcl
//Purpose: Link file for use with LPC210x to run in internal RAM
//-------- END-OF-HEADER -----------------------------------------------
//

-carm    // Define CPU

// Address map
-DRAM_BASE_ADDR=40000000      // physical address

-DRAM_SIZE=4000               // Total amount must not exceeed internal RAM size

-DROMSTART=(RAM_BASE_ADDR+200)  // Code is linked to run in internal RAM + space margin for bootloader
-DROMEND=(RAM_BASE_ADDR+RAM_SIZE-1)
-DRAMSTART=(ROMSTART)
-DRAMEND=(ROMEND)

// Internal RAM, used for CSTACK and IRQ_STACK
-DIRAMSTART=RAMSTART
-DIRAMEND=RAMEND

//**********************************************************************
// Read only segments that are mapped to ROM.
//**********************************************************************

//************************************************
// Address range for reset and exception
// vectors (INTVEC).
// The vector area is 32 bytes, 
// an additional 32 bytes is allocated for the
// constant table used by ldr PC in cstartup.s79.
//************************************************

-Z(CODE)INTVEC=40000000-4000003F

//************************************************
// Startup code and exception routines (ICODE).
//************************************************

-Z(CODE)ICODE,DIFUNCT=ROMSTART-ROMEND
-Z(CODE)SWITAB=ROMSTART-ROMEND

//************************************************
// Code segments may be placed anywhere.
//************************************************

-Z(CODE)CODE=ROMSTART-ROMEND

//************************************************
// Original ROM location for __ramfunc code copied
// to and executed from RAM.
//************************************************

-Z(CONST)CODE_ID=ROMSTART-ROMEND

//************************************************
// Various constants and initializers.
//************************************************

-Z(CONST)INITTAB,DATA_ID,DATA_C=ROMSTART-ROMEND
-Z(CONST)CHECKSUM=ROMSTART-ROMEND

//************************************************
// Data segments.
//************************************************

-Z(DATA)DATA_I,DATA_Z,DATA_N=RAMSTART-RAMEND

//************************************************
// __ramfunc code copied to and executed from RAM.
//************************************************

-Z(DATA)CODE_I=RAMSTART-RAMEND

//************************************************
// ICCARM produces code for __ramfunc functions in
// CODE_I segments. The -Q XLINK command line
// option redirects XLINK to emit the code in the
// CODE_ID segment instead, but to keep symbol and
// debug information associated with the CODE_I
// segment, where the code will execute.
//************************************************

-QCODE_I=CODE_ID

//*************************************************************************
// Stack and heap segments.
//*************************************************************************

// For embOS, only CSTACK and IRQ_STACK are required
// Define other stacks if needed by application
-Z(DATA)CSTACK+200,IRQ_STACK+200,HEAP+0=IRAMSTART-IRAMEND

//**********************************************************************
// End of File
//**********************************************************************
